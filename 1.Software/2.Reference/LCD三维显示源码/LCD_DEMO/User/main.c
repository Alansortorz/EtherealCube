/*******************************************************************************
* 工程: 基于STC单片机“12864液晶显示旋转的立方体和图片(优化算法)”实例
* 编译: Keil uVersion 3
* 创建: 2014-11-26 15:57:14
* 更新: NULL
* 版本: 1.0
*******************************************************************************/
/*******************************************************************************
* 文档: main.c
* 作者: Wu LianWei
* 描述: 1.三维图形变换操作
*       2.transform_3D.c文档中包含“变换算法”
*       3.projection.c文档中包含“投影算法”
*       4.rotation_cube.c文档应用“变换矩阵算法”和“投影算法”实现旋转立方体
*       5.rotation_font3D.c文档实现三维空间中旋转图片(优化算法)
*       6.三维图形变换基于“变换矩阵算法”和“投影算法”来构建新坐标
*       7.显示效果是 立方体绕Y轴旋转,图片也随之旋转。
*******************************************************************************/
#include "STC15F2K60S2.h"
#include "public.h"
#include "rtc.h"
#include "lcd_drive.h"
#include "dis_general.h"
#include "rotation_cube.h"
#include "rotation_font3D.h"
#include "font.h"



/******************************************************************************/
/* 程序变量定义                                                               */
/******************************************************************************/
volatile bit flash;    //闪烁标志
float idata turn;	   //转向角度
uchar idata pic;
sbit BG = P0^5; //低电平有效



/******************************************************************************/
/* MAIN主程序                                                                 */
/******************************************************************************/
void main(void)
{
    WDT_CONTR = 0x05; //关闭看门狗
    //--------------------------------
    RTC_cfg();		//配置实时时钟(启动定时器0)
    LcdInit();		//LCD12864初始化
    ClearScreen();	//清空屏幕
    //------------
    turn=0;			//转向角度置0
    pic=0;
    
    while(1)
    {
        if(T20msFlg)	//每过20ms处理事件标志位
        {
            T20msFlg=0;
            //-----------------
            ClearDis();	//清缓存也可以理解为清屏
            
            RotateCube2(0,turn,0);	//立方体旋转计算并写入缓存区
            //RotatePic32x32(&SETICO[pic][0],0,turn,0);		//固定32*32旋转
            BG = 0;		//打开LCD片选
            
            RefreshScreen(); //将缓存区发送到LCD显示
        }
		
        if(T100msFlg)	//每过100ms处理事件标志位
        {
            T100msFlg=0;
            //-----------------
            turn+=1;				//每过100ms将旋转的角度加1
            if(turn>=360)turn=0;
            if(turn==280) //270
            {
                pic++;
                if(pic>7)pic=0;
            }
            
        }
		
        if(T500msFlg)	//每过500ms处理事件标志位
        {
            T500msFlg=0;
            //-----------------
            flash=!flash;       //闪烁标志
            
        }
		
        if(T1sFlg)		//每过1s处理事件标志位
        {
            T1sFlg=0;
            //-----------------
            
        }
    }
}
